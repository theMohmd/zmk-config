## config/boards/shields/Nomad/Kconfig.defconfig
```kconfig
if SHIELD_NOMAD_LEFT

config ZMK_KEYBOARD_NAME
    default "Nomad"

config ZMK_SPLIT_ROLE_CENTRAL
    default y

endif

if SHIELD_NOMAD_LEFT || SHIELD_NOMAD_RIGHT

config ZMK_SPLIT
    default y

endif
```

## config/boards/shields/Nomad/Kconfig.shield
```kconfig
config SHIELD_NOMAD_LEFT
    def_bool $(shields_list_contains,Nomad_left)

config SHIELD_NOMAD_RIGHT
    def_bool $(shields_list_contains,Nomad_right)
```
