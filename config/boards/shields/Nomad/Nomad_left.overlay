#include "Nomad.dtsi"

&kscan0 {
    row-gpios =
      <&gpio0 11 (GPIO_ACTIVE_HIGH | GPIO_PULL_DOWN)>,
      <&gpio0 29 (GPIO_ACTIVE_HIGH | GPIO_PULL_DOWN)>,
      <&gpio0 31 (GPIO_ACTIVE_HIGH | GPIO_PULL_DOWN)>,
      <&gpio0 10 (GPIO_ACTIVE_HIGH | GPIO_PULL_DOWN)>;

    col-gpios =
      <&gpio0 9 GPIO_ACTIVE_HIGH>,
      <&gpio0 2 GPIO_ACTIVE_HIGH>,
      <&gpio1 15 GPIO_ACTIVE_HIGH>,
      <&gpio1 4 GPIO_ACTIVE_HIGH>,
      <&gpio1 0 GPIO_ACTIVE_HIGH>,
      <&gpio1 6 GPIO_ACTIVE_HIGH>;
};
